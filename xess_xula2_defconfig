## xess_xula2_defconfig
```kconfig
#### Buildroot configuration file  #######

BR2_microblaze=y
BR2_microblazeel=y
BR2_TARGET_GENERIC_GETTY_PORT="ttyUL0"
BR2_TARGET_GENERIC_GETTY_BAUDRATE_115200=y
BR2_TARGET_GENERIC_GETTY_BAUDRATE="115200"
BR2_TARGET_GENERIC_GETTY_TERM="vt100"
BR2_TARGET_GENERIC_GETTY_OPTIONS=""
# BR2_TARGET_ROOTFS_TAR is not set
BR2_TARGET_ROOTFS_INITRAMFS=y
BR2_LINUX_KERNEL=y
BR2_LINUX_KERNEL_USE_CUSTOM_CONFIG=y
BR2_LINUX_KERNEL_CUSTOM_CONFIG_FILE="board/xess/xula2/xula2_defconfig"
BR2_LINUX_KERNEL_USE_CUSTOM_DTS=y
BR2_LINUX_KERNEL_CUSTOM_DTS_PATH="board/xess/xula2/xula2.dts"

BR2_TARGET_GENERIC_HOSTNAME="Xula2"
BR2_TARGET_GENERIC_ISSUE="Welcome to Xula2 + MicroBlaze + Buildroot"

BR2_KERNEL_HEADERS_4_4=y
BR2_DEFAULT_KERNEL_HEADERS="4.4.3"
```
